## west.yml
```yaml
# Copyright (c) 2025 CATIE
# SPDX-License-Identifier: Apache-2.0

manifest:
  remotes:
    - name: STMicroelectronics
      url-base: https://github.com/STMicroelectronics
    - name: Catie
      url-base: https://github.com/catie-aq
  defaults:
    remote: Catie

  projects:
    - name: stselib
      repo-path: STSELib-fork
      # repo-path: STSELib
      revision: 836b54b2c016f7250bd2885a722af04e44f6864a
      path: modules/lib/stselib
```
